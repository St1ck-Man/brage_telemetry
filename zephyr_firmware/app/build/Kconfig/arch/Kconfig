## zephyr_firmware/app/build/Kconfig/arch/Kconfig
```kconfig
# Load Zephyr Arch Kconfig descriptions.
osource "/home/yeet/Projects/brage_telemetry/zephyr_firmware/zephyr/arch/rx/Kconfig"
osource "/home/yeet/Projects/brage_telemetry/zephyr_firmware/zephyr/arch/x86/Kconfig"
osource "/home/yeet/Projects/brage_telemetry/zephyr_firmware/zephyr/arch/xtensa/Kconfig"
osource "/home/yeet/Projects/brage_telemetry/zephyr_firmware/zephyr/arch/sparc/Kconfig"
osource "/home/yeet/Projects/brage_telemetry/zephyr_firmware/zephyr/arch/riscv/Kconfig"
osource "/home/yeet/Projects/brage_telemetry/zephyr_firmware/zephyr/arch/posix/Kconfig"
osource "/home/yeet/Projects/brage_telemetry/zephyr_firmware/zephyr/arch/mips/Kconfig"
osource "/home/yeet/Projects/brage_telemetry/zephyr_firmware/zephyr/arch/arm64/Kconfig"
osource "/home/yeet/Projects/brage_telemetry/zephyr_firmware/zephyr/arch/arm/Kconfig"
osource "/home/yeet/Projects/brage_telemetry/zephyr_firmware/zephyr/arch/arc/Kconfig"
```

## zephyr_firmware/app/build/Kconfig/boards/Kconfig
```kconfig
# Load Zephyr board Kconfig descriptions.
osource "/home/yeet/Projects/brage_telemetry/zephyr_firmware/zephyr/boards/st/nucleo_c092rc/Kconfig"
```

## zephyr_firmware/app/build/Kconfig/boards/Kconfig.defconfig
```kconfig
# Load Zephyr board defconfig descriptions.
osource "/home/yeet/Projects/brage_telemetry/zephyr_firmware/zephyr/boards/st/nucleo_c092rc/Kconfig.defconfig"
```

## zephyr_firmware/boards/vendor/brage/Kconfig.brage
```kconfig
# Copyright (c) 2024
# SPDX-License-Identifier: Apache-2.0

config BOARD_BRAGE
	bool "Brage 1.0"
	depends on SOC_STM32U575XX
	select SOC_STM32U575CG
```

## zephyr_firmware/boards/vendor/brage/brage_defconfig
```kconfig
# Copyright (c) 2024
# SPDX-License-Identifier: Apache-2.0

CONFIG_SOC_SERIES_STM32U5X=y
CONFIG_SOC_STM32U575XX=y

# Board identifier
CONFIG_BOARD_BRAGE=y

# General Kernel Options
CONFIG_CORTEX_M_SYSTICK=y

# Serial Drivers
CONFIG_SERIAL=y
CONFIG_UART_INTERRUPT_DRIVEN=y
CONFIG_CONSOLE=y
CONFIG_UART_CONSOLE=y

# GPIO
CONFIG_GPIO=y

# Clock configuration
CONFIG_CLOCK_CONTROL=y
CONFIG_CLOCK_STM32_HSE_CLOCK=48000000
CONFIG_CLOCK_STM32_SYSCLK_SRC_PLL=y
CONFIG_CLOCK_STM32_PLL_SRC_HSE=y
CONFIG_CLOCK_STM32_PLL_M_DIVISOR=3
CONFIG_CLOCK_STM32_PLL_N_MULTIPLIER=10
CONFIG_CLOCK_STM32_PLL_P_DIVISOR=2
CONFIG_CLOCK_STM32_PLL_Q_DIVISOR=2
CONFIG_CLOCK_STM32_PLL_R_DIVISOR=1
CONFIG_CLOCK_STM32_AHB_PRESCALER=1
CONFIG_CLOCK_STM32_APB1_PRESCALER=1
CONFIG_CLOCK_STM32_APB2_PRESCALER=1
CONFIG_CLOCK_STM32_APB3_PRESCALER=1

# Enable HW stack protection
CONFIG_HW_STACK_PROTECTION=y

# Enable MPU
CONFIG_ARM_MPU=y

# Enable SPI
CONFIG_SPI=y
CONFIG_SPI_STM32_INTERRUPT=y

# Enable CAN
CONFIG_CAN=y

# Enable ADC
CONFIG_ADC=y

# Enable USB
CONFIG_USB_DEVICE_STACK=y

# Enable pin controller
CONFIG_PINCTRL=y
```
